#include  "includes.h"


//*************************************************************************
/*
函数名称:LCD_star
函数功能:在LCD屏上显示五角星
函数参数：无
函数返回值：无
*/
void LCD_star(void)
{
	int i;
	//定义结构体为保存字模
	u8 zf_L[] =
 {   
    0x01,0x00,0x01,0x00,0x02,0x80,0x02,0x80,0x02,0x80,0x04,0x40,0xFC,0x7E,0x40,0x04,
    0x30,0x18,0x08,0x20,0x08,0x20,0x11,0x90,0x16,0x50,0x18,0x30,0x20,0x08,0x00,0x00,
 };
 
 for (i = 0;i < 240;i++)
	{
		show_xXx(120,160,RED,BLUE,zf_L,16,16);//显示字符
				Delay_us(100000);
	}
}

//*******************************************************************************
/*
函数名称:LCD_ceil
函数功能:在LCD屏上画圆
函数参数：无
函数返回值：无
*/
void LCD_ceil(void)
{
		double i,j;
		for (i = 0;i < 240;i++)
		{                                                                                                                                                                                                                                                
				for (j = 0;j < 240;j++)
				{
						if (((i-120)*(i-120) + (j-120)*(j-120) == 100*100) | ((i-120)*(i-120) + (120-j)*(120-j) == 100*100) | ((120-i)*(120-i) + (j-120)*(j-120) == 100*100) | ((120-i)*(120-i) + (120-j)*(120-j) == 100*100))
										LCD_DrawPoint(i,j,RED);
				}
		}
}

//*********************************************************************************************************
/*
函数名称:LCD_char
函数功能:在LCD屏上显示滚动字符
函数参数：无
函数返回值：无
*/
void LCD_char(void)
{
	u8 zf_L[] = {
	0x00,0x00,0x00,0x10,0x10,0x18,0x28,0x28,0x24,0x3C,0x44,0x42,0x42,0xE7,0x00,0x00
	};
	int i;
	while (1)
	{
		for (i = 0;i < 240;i++)
		{
				show_xXx((0+i),160,RED,BLUE,zf_L,16,8);
				Delay_us(100000);
		}
	}
}

//************************************************************************************
/*
函数名称:LCD_picture
函数功能:在LCD屏上显示滚动字符
函数参数：无
函数返回值：无
*/
void LCD_picture(void)
{
		while (1)
	{
		
	}
}




